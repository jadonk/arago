## conf/local.conf
```bitbake
# WARNING: lines starting with a space (' ') will result in parse failures.
# Remove '# ' from commented lines to activate them.
#
# NOTE: Do NOT use $HOME in your paths, BitBake does NOT expand ~ for you.  If you
# must have paths relative to your homedir use ${HOME} (note the {}'s there
# you MUST have them for the variable expansion to be done by BitBake).  Your
# paths should all be absolute paths (They should all start with a / after
# expansion.  Stuff like starting with ${HOME} or ${TOPDIR} is ok).

# Use this to specify where BitBake should place the downloaded sources into
DL_DIR = "${OEBASE}/downloads"

LOCALDIR = "${OEBASE}/ofb"
UPSTREAMDIR = "${OEBASE}/ofb-oe-dev"

BBFILES = "${UPSTREAMDIR}/packages/*/*.bb ${LOCALDIR}/packages/*/*.bb"

# Overlays
BBFILE_COLLECTIONS = "upstream local"
BBFILE_PATTERN_upstream = "^${UPSTREAMDIR}/packages/"
BBFILE_PATTERN_local = "^${LOCALDIR}/packages/"
BBFILE_PRIORITY_upstream = "5"
BBFILE_PRIORITY_local = "10"

# Use the BBMASK below to instruct BitBake to _NOT_ consider some .bb files
# This is a regulary expression, so be sure to get your parenthesis balanced.
BBMASK = ""

SDK_PREFIX = "/opt/arm-2007q3"

# Don't use these for now
# TARGET_PREFIX = "arm-none-linux-gnueabi-"
# TARGET_CPPFLAGS_append = " -I${PRE_BUILT}/usr/include "
# TARGET_LDFLAGS_prepend = " -L${PRE_BUILT} -Wl,-rpath-link,${PRE_BUILT}/lib "
ASSUME_SHLIBS += "libc.so.6:libc6 libm.so.6:libc6 libutil.so.1:libc6 libcrypt.so.1:libc6"
ASSUME_SHLIBS += "libdl.so.2:libc6 libpthread.so.0:libc6 librt.so.1:libc6 libgcc_s.so.1:libgcc1"

# Move this to the machine definition later
PREFERRED_PROVIDER_virtual/kernel = "linux-omap3"
PREFERRED_VERSION_virtual/kernel = "2.6.22+psp"

#MACHINE_ESSENTIAL_EXTRA_RDEPENDS = "alsa-lib alsa-utils tslib zlib ncurses libpng jpeg freetype mtd-utils thttpd"
MACHINE_ESSENTIAL_EXTRA_RDEPENDS = "alsa-lib tslib zlib ncurses libpng jpeg freetype mtd-utils thttpd"

# Disable DropBear for now due to export restrictions
DISTRO_SSH_DAEMON = ""

# Changing TMPDIR and PSTAGE variables will disable packaged staging and
# force rebuilding of native packages
#TMPDIR = "${OEBASE}/${DISTRO}-tmp"
TMPDIR = "/tmp/ofb"
DEPLOY_DIR_PSTAGE = "${TMPDIR}/pstage"

IMAGE_ROOTFS_SIZE_ext2.gz = "16384"

MACHINE = "omap3evm"
# MACHINE = "beagleboard"
# MACHINE = "davinci-dvevm"

# DISTRO = "minimal-sdk"
DISTRO = "angstrom-2008.1"

# So far, angstrom.conf sets ENABLE_BINARY_LOCALE_GENERATION
# to generate binary locale packages at build time using qemu-native and
# thereby guarantee i18n support on all devices. If your build breaks on 
# qemu-native consider disabling ENABLE_BINARY_LOCALE_GENERATION (note that
# this breaks i18n on devices with less than 128MB RAM) or installing
# a working third-party qemu (e.g. provided by your distribution) and
# adding qemu-native to ASSUME_PROVIDED. Caveat emptor, since third-party
# qemus lack patches needed to work with various OE targets.
ENABLE_BINARY_LOCALE_GENERATION = "0"
# ASSUME_PROVIDED += "qemu-native"

# If ENABLE_BINARY_LOCALE_GENERATION is set to "1", you can limit locales
# generated to the list provided by GLIBC_GENERATE_LOCALES. This is huge
# time-savior for developmental builds. Format: list of locale.encoding pairs
# with spaces as separators.
# GLIBC_GENERATE_LOCALES = "en_GB.UTF-8 de_DE.UTF-8"

#INHERIT += "oestats-client"
#OESTATS_SERVER = "tinderbox.openembedded.net"
#OESTATS_BUILDER = "username"

# Add the required image file system types below. Valid are 
# jffs2, tar(.gz|bz2), cpio(.gz), cramfs, ext2(.gz), ext3(.gz)
# squashfs, squashfs-lzma
IMAGE_FSTYPES = "jffs2 tar.bz2 ext2.gz"

# Uncomment this if you want BitBake to emit debugging output
# BBDEBUG = "yes"

# Uncomment these two if you want BitBake to build images useful for debugging. 
# Note that INHIBIT_PACKAGE_STRIP needs a package format to be defined.
# Also note that OE now produces -dbg packages which contain debugging symbols.
# DEBUG_BUILD = "1"
# INHIBIT_PACKAGE_STRIP = "1"

# Uncomment these to build a package such that you can use gprof to profile it.
# NOTE: This will only work with 'linux' targets, not
# 'linux-uclibc', as uClibc doesn't provide the necessary
# object files.  Also, don't build glibc itself with these
# flags, or it'll fail to build.
#
# PROFILE_OPTIMIZATION = "-pg"
# SELECTED_OPTIMIZATION = "${PROFILE_OPTIMIZATION}"
# LDFLAGS =+ "-pg"

# Uncomment this to enable parallel make.
# This allows make to spawn mutliple processes to take advantage of multiple 
# processors. Useful on SMP machines. This may break some packages - we're
# in the process of marking these so let us know if you find any.
#PARALLEL_MAKE = "-j 4"
#BB_NUMBER_THREADS = "4"

# Uncomment this if you want BitBake to emit the log if a build fails.
BBINCLUDELOGS = "yes"
```

## conf/machine/arago.conf
```bitbake
#@TYPE: Machine
#@NAME: Arago unified machine
#@DESCRIPTION: Unified Arago machine configuration for the TI OMAP3 and DaVinci platforms
TARGET_ARCH = "arm"

PREFERRED_PROVIDER_virtual/xserver = "xserver-kdrive"
XSERVER = "xserver-kdrive-fbdev"
GUI_MACHINE_CLASS = "smallscreen"

#include conf/machine/include/tune-cortexa8.inc
include conf/machine/include/tune-arm926ejs.inc

# Ship all kernel modules
MACHINE_EXTRA_RRECOMMENDS = " kernel-modules"

IMAGE_FSTYPES ?= "jffs2 tar.bz2"
EXTRA_IMAGECMD_jffs2 = "-lnp "

SERIAL_CONSOLE = "115200 ttyS0"

#PREFERRED_PROVIDER_virtual/kernel ?= "linux-omap3"
#PREFERRED_VERSION_virtual/kernel ?= "2.6.22+psp"

PREFERRED_PROVIDER_virtual/kernel ?= "linux-omap2"

KERNEL_IMAGETYPE = "uImage"

UBOOT_ENTRYPOINT = "0x80008000"
UBOOT_LOADADDRESS = "0x80008000"
UBOOT_ARCH = "arm"

MACHINE_FEATURES = "kernel26 apm usbgadget usbhost vfat ext2 screen touchscreen"
```
